/*
 * Tracking System
 * 
 * Created on : Nov 23, 2022 
 *
 * Author: Parikshit Pagare
 * github.com/parikshitpagare
 * linkedin.com/in/parikshitpagare 
 * 
 * Project link: github.com/parikshitpagare/tracking-system-rtos
 * 
 * MIT License 
 */

#include <HardwareSerial.h>
#include "TinyGPS++.h"
#include "DHT.h"
#include <Wire.h>
#include <Adafruit_SSD1306.h>
#include <Adafruit_GFX.h>
#include <cmath>

/* Using core 1 of ESP32 */
#if CONFIG_FREERTOS_UNICORE
static const BaseType_t app_cpu = 0;
#else
static const BaseType_t app_cpu = 1;
#endif

/* Sensor pins */
#define DHTPIN 32  // DHT11 temperature sensor
#define DHTTYPE DHT11
#define xInput A0                 // ADXL335 x-axis
#define yInput A3                 // ADXL335 y-axis
#define zInput A6                 // ADXL335 z-axis
#define button 19                 // Push button for OLED display
#define rgbLED_blue 25            // RGB led Red color
#define rgbLED_green 26           // RGB led Green color
#define rgbLED_red 27             // RGB led Blue color

/* Parameters for UART */
#define SERIAL_BAUD 115200        // Baud rate for ESP32 UART
#define GSM_BAUD 115200           // Baud rate for GSM module UART
#define GPS_BAUD 115200             // Baud rate for GPS module UART
#define SERIAL_BUFFER_SIZE 1024
#define GSM_BUFFER_SIZE 1024
#define GPS_BUFFER_SIZE 1024


/* Rx and Tx pins for GSM and GPS */
#define RXD1 13
#define TXD1 14
#define RXD2 16
#define TXD2 17

/* Parameters for temperature and accelerometer */
#define TEMP_THRESHOLD 32         // Threshold value for temperature
#define ADXL_THRESHOLD 35         // Threshold value for accelerometer
#define SAMPLE_SIZE 10            // Take multiple samples to reduce noise

/* Setting OLED display parameters */
#define SCREEN_WIDTH 128          // OLED display width, in pixels
#define SCREEN_HEIGHT 64          // OLED display height, in pixels
#define SCREEN_ADDRESS 0x3C       // I2C address for OLED display
#define OLED_RESET -1

/* Defining objects */
HardwareSerial GSM(1);
HardwareSerial GPS(2);
DHT dht(DHTPIN, DHTTYPE);
TinyGPSPlus gps;
Adafruit_SSD1306 display(SCREEN_WIDTH, SCREEN_HEIGHT, &Wire, OLED_RESET);

/* Defining queues */
static QueueHandle_t tempQueue;
static QueueHandle_t adxlQueue_x;
static QueueHandle_t adxlQueue_y;
static QueueHandle_t adxlQueue_z;
static QueueHandle_t gpsQueue_lat;
static QueueHandle_t gpsQueue_lon;
static QueueHandle_t gpsQueue_sat;
static QueueHandle_t gsmQueue_lat;
static QueueHandle_t gsmQueue_lon;
static QueueHandle_t gsmQueue_temp;
static QueueHandle_t gsmQueue_x;
static QueueHandle_t gsmQueue_y;
static QueueHandle_t gsmQueue_z;

/* Initializing global variables*/
int oledDisplayState = 0;

/**********************************************
  Setup
**********************************************/

void setup() {
  /* Setting UART buffer size */
  Serial.setRxBufferSize(SERIAL_BUFFER_SIZE);
  Serial.setTxBufferSize(SERIAL_BUFFER_SIZE);
  GSM.setRxBufferSize(GSM_BUFFER_SIZE);
  GSM.setTxBufferSize(GSM_BUFFER_SIZE);

  /* Initializing */
  Serial.begin(SERIAL_BAUD, SERIAL_8N1);
  GSM.begin(GSM_BAUD, SERIAL_8N1, RXD1, TXD1);
  GPS.begin(GPS_BAUD, SERIAL_8N1, RXD2, TXD2);
  Wire.begin();
  dht.begin();
  display.begin(SSD1306_SWITCHCAPVCC, SCREEN_ADDRESS);  // Initialize OLED with I2C address 0x3C

  /* Defining pin modes */
  pinMode(button, INPUT_PULLUP);
  pinMode(rgbLED_red, OUTPUT);
  pinMode(rgbLED_green, OUTPUT);
  pinMode(rgbLED_blue, OUTPUT);

  /* OLED display on start */
  introDisplay();
  initDisplay();
  configGPRS();

  /* Creating queue for passing temperature data */
  tempQueue = xQueueCreate(10, sizeof(int));
  gsmQueue_temp = xQueueCreate(10, sizeof(int));

  /* Creating queue for passing accelerometer data */
  adxlQueue_x = xQueueCreate(10, sizeof(int));
  adxlQueue_y = xQueueCreate(10, sizeof(int));
  adxlQueue_z = xQueueCreate(10, sizeof(int));
  gsmQueue_x = xQueueCreate(10, sizeof(int));
  gsmQueue_y = xQueueCreate(10, sizeof(int));
  gsmQueue_z = xQueueCreate(10, sizeof(int));
  
  /* Creating queue for passing GPS data */
  gpsQueue_lat = xQueueCreate(10, sizeof(float));
  gpsQueue_lon = xQueueCreate(10, sizeof(float));
  gpsQueue_sat = xQueueCreate(10, sizeof(int));
  gsmQueue_lat = xQueueCreate(10, sizeof(float));
  gsmQueue_lon = xQueueCreate(10, sizeof(float));
  
  /* Creating tasks */
  xTaskCreatePinnedToCore(tempRead, "Temperature", 2048, NULL, 1, NULL, app_cpu);
  xTaskCreatePinnedToCore(adxlRead, "Accelerometer", 2048 * 2, NULL, 1, NULL, app_cpu);
  xTaskCreatePinnedToCore(gpsRead, "GPS", 2048, NULL, 1, NULL, app_cpu);
  xTaskCreatePinnedToCore(gsmSend, "GSM", 2048 * 2, NULL, 1, NULL, app_cpu);
  xTaskCreatePinnedToCore(displayButton, "Button", 2048, NULL, 1, NULL, app_cpu);
  xTaskCreatePinnedToCore(displayLocation, "OLED display", 4096 * 2, NULL, 1, NULL, app_cpu);
  xTaskCreatePinnedToCore(displayTemperature, "OLED display", 4096 * 2, NULL, 1, NULL, app_cpu);
  xTaskCreatePinnedToCore(displayAccelerometer, "OLED display", 4096 * 2, NULL, 1, NULL, app_cpu);
}

void loop() {
  vTaskDelay(10 / portTICK_PERIOD_MS);
}

/**********************************************
  Tasks for Sensors
**********************************************/

/* Task for getting latitude and longitude using Quectel L89H */
void gpsRead(void *parameter) {
  float lat = 0;
  float lon = 0;
  int sat = 0;

  while (true) {
    while (GPS.available() > 0) {
      if (gps.encode(GPS.read())) {
        if (gps.location.isValid()) {
          lat = (gps.location.lat() + 1);
          lon = (gps.location.lng() + 1);
          sat = (gps.satellites.value());
        }
      }
    }
    /* Passing the location and satellite data using queue to 
    'displayLocation' and 'gsmSend' tasks every 10 ticks */
    xQueueSend(gpsQueue_lat, (void *)&lat, 10);
    xQueueSend(gpsQueue_lon, (void *)&lon, 10);
    xQueueSend(gpsQueue_sat, (void *)&sat, 10);
    xQueueSend(gsmQueue_lat, (void *)&lat, 10);
    xQueueSend(gsmQueue_lon, (void *)&lon, 10);

    /* Task delay for 5000ms */
    vTaskDelay(5000 / portTICK_PERIOD_MS);
  }
}

/* Task for temperature sensing using DHT11 */
void tempRead(void *parameter) {
  int temp = 0;

  while (true) {
    /* Retrieve temperature in Celcius*/
    temp = dht.readTemperature();

    /* Display error if DHT11 failed*/
    if (isnan(temp)) {
      Serial.println(F("Failed to read from DHT sensor!"));
      return;
    }
    
    /* Passing the temperature data using queue to 
    'displayTemperature' and 'gsmSend' tasks every 10 ticks */
    xQueueSend(tempQueue, (void *)&temp, 10);
    xQueueSend(gsmQueue_temp, (void *)&temp, 10);

    /* Updating the LED status based on the threshold */
    if (temp > TEMP_THRESHOLD) {
      rgbLEDHigh();
    } else {
      rgbLEDLow();
    }
    
    /* Task delay for 5000ms*/
    vTaskDelay(5000 / portTICK_PERIOD_MS);
  }
}

/* Task for measuring vibration using ADXL335 */
void adxlRead(void *parameter) {
  int xValueCurrent = 0;
  int yValueCurrent = 0;
  int zValueCurrent = 0;
  int xValueLast = 0;
  int yValueLast = 0;
  int zValueLast = 0;
  int xChange = 0;
  int yChange = 0;
  int zChange = 0;
  int tempValue = 0;

  while (true) {
    /* Reading the analog values */
    xValueCurrent = readAxis(xInput);
    yValueCurrent = readAxis(yInput);
    zValueCurrent = readAxis(zInput);

    /* Calculating the change in current and previous values */
    xChange = (xValueCurrent - xValueLast);
    yChange = (yValueCurrent - yValueLast);
    zChange = (zValueCurrent - zValueLast);

    /* Passing the accelerometer data using queue to 
    'displayAccelerometer' and 'gsmSend' tasks every 5 ticks */
    xQueueSend(adxlQueue_x, (void *)&xChange, 5);
    xQueueSend(adxlQueue_y, (void *)&yChange, 5);
    xQueueSend(adxlQueue_z, (void *)&zChange, 5);
    xQueueSend(gsmQueue_x, (void *)&xChange, 5);
    xQueueSend(gsmQueue_y, (void *)&yChange, 5);
    xQueueSend(gsmQueue_z, (void *)&zChange, 5);

    /* Checking if change in value is below or above the threshold */
    if (abs(xChange) > ADXL_THRESHOLD || abs(yChange) > ADXL_THRESHOLD || abs(zChange) > ADXL_THRESHOLD) {
      rgbLEDHigh();
    } else {
      rgbLEDLow();
    }

    /* Storing the current value as last value*/
    xValueLast = xValueCurrent;
    yValueLast = yValueCurrent;
    zValueLast = zValueCurrent;
    
    /* Task delay for 50ms*/
    vTaskDelay(50 / portTICK_PERIOD_MS);
  }
}

/**********************************************
Task for GSM
**********************************************/

void gsmSend(void *parameter) {
  String url, lat, lon, temp, vibX, vibY, vibZ;
  float latValue;
  float lonValue;
  int tempValue;
  int xChangeValue;
  int yChangeValue;
  int zChangeValue;

  while (true) {
    /* Receiving the location data via queue from 
    'gpsRead' task every 0 ticks */
    xQueueReceive(gsmQueue_lat, (void *)&latValue, 0);
    xQueueReceive(gsmQueue_lon, (void *)&lonValue, 0);
    
    /* Receiving the temperature data via queue from 
    'tempRead' task every 0 ticks */
    xQueueReceive(gsmQueue_temp, (void *)&tempValue, 0);
    
    /* Receiving the accelerometer data via queue from 
    'adxlRead' task every 0 ticks */
    xQueueReceive(gsmQueue_x, (void *)&xChangeValue, 0);
    xQueueReceive(gsmQueue_y, (void *)&yChangeValue, 0);
    xQueueReceive(gsmQueue_z, (void *)&zChangeValue, 0);

    lat = String(latValue);
    lon = String(lonValue);
    temp = String(tempValue);
    vibX = String(xChangeValue);
    vibY = String(yChangeValue);
    vibZ = String(zChangeValue);

    /* URL structure for sending the data using HTTP GET method */
    url = "http://167.71.238.230/backend-php/db-sensors.php?lat=";
    url += lat;
    url += "&lon=";
    url += lon;
    url += "&temp=";
    url += temp;
    url += "&x=";
    url += vibX;
    url += "&y=";
    url += vibY;
    url += "&z=";
    url += vibZ;

    GSM.print("AT+HTTPPARA=\"URL\",\"");
    GSM.print(url);
    sendATcommand("\"", "OK", 2000);
    sendATcommand("AT+HTTPACTION=0", "0,200", 2000);

  /* Task delay for 100ms*/
    vTaskDelay(200 / portTICK_PERIOD_MS);
  }
}

/**********************************************
Tasks for OLED display
**********************************************/

/* Task for changing OLED display mode using push button */
void displayButton(void *parameter) {
  int buttonState;
  int debounceDelay = 200;

  while (true) {
    int buttonState = digitalRead(button);
    vTaskDelay(debounceDelay / portTICK_PERIOD_MS);

    if (buttonState == LOW) {
      oledDisplayState++;
      if (oledDisplayState > 2) {
        oledDisplayState = 0;
      }
    } 
    else if (buttonState == HIGH) {
      /* Do nothing */
    }
  }
}

/* Task for displaying GPS data on OLED display */
void displayLocation(void *parameter) {
  float latValue;
  float lonValue;
  int satValue;

  const unsigned char gpsIndicator[] PROGMEM = {
    0x00, 0x00, 0x00, 0x00, 0x00, 0x00, 0x00, 0x00, 0x00, 0x00, 0x00, 0x00, 0x00, 0x00, 0x00, 0x00,
    0x00, 0x00, 0x00, 0x00, 0x00, 0x00, 0x00, 0x00, 0x00, 0x00, 0x00, 0x00, 0x00, 0x00, 0x00, 0x00,
    0x00, 0x00, 0x00, 0x00, 0x00, 0x00, 0x00, 0x00, 0x00, 0x00, 0x00, 0x00, 0x00, 0x00, 0x00, 0x00,
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    0x00, 0x00, 0x00, 0x00, 0x00, 0x00, 0x00, 0x00, 0x00, 0x00, 0x00, 0x00, 0x00, 0x00, 0x00, 0x00
  };

  while (true) {
    xQueueReceive(gpsQueue_lat, (void *)&latValue, 0);
    xQueueReceive(gpsQueue_lon, (void *)&lonValue, 0);
    xQueueReceive(gpsQueue_sat, (void *)&satValue, 0);

    display.setTextColor(WHITE);  // Set the color

    if (oledDisplayState == 0) {
      display.drawBitmap(5, 0, gpsIndicator, 128, 64, WHITE);

      display.setTextSize(1);
      display.setCursor(53, 8);
      display.print("Sat:");
      display.print(satValue);

      display.setTextSize(2);
      display.setCursor(53, 20);
      display.print(latValue);
      display.setCursor(53, 40);
      display.print(lonValue);

      display.display();
      display.clearDisplay();
    }
  }
}

/* Task for displaying temperature on OLED dsiplay */
void displayTemperature(void *parameter) {
  int tempValue;

  const unsigned char tempIndicator[] PROGMEM = {
    0x00, 0x00, 0x00, 0x00, 0x00, 0x00, 0x00, 0x00, 0x00, 0x00, 0x00, 0x00, 0x00, 0x00, 0x00, 0x00,
    0x00, 0x00, 0x00, 0x00, 0x00, 0x00, 0x00, 0x00, 0x00, 0x00, 0x00, 0x00, 0x00, 0x00, 0x00, 0x00,
    0x00, 0x00, 0x00, 0x00, 0x00, 0x00, 0x00, 0x00, 0x00, 0x00, 0x00, 0x00, 0x00, 0x00, 0x00, 0x00,
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    0x00, 0x00, 0x00, 0x00, 0x00, 0x00, 0x00, 0x00, 0x00, 0x00, 0x00, 0x00, 0x00, 0x00, 0x00, 0x00
  };

  display.setTextColor(WHITE);  // Set the color

  while (true) {
    xQueueReceive(tempQueue, (void *)&tempValue, 0);

    if (oledDisplayState == 1) {
      display.drawBitmap(5, 0, tempIndicator, 128, 64, WHITE);

      if (tempValue <= TEMP_THRESHOLD) {
        display.setTextSize(1);
        display.setCursor(64, 20);
        display.print("Ambient");
      } else {
        display.setTextSize(1);
        display.setCursor(64, 20);
        display.print("Critical");
      }

      display.setTextSize(2);
      display.setCursor(64, 32);  // Set the cursor coordinates
      display.print(tempValue);
      display.print((char)247);
      display.print("C");

      display.display();
      display.clearDisplay();
    }
  }
}

/* Task for displaying accelerometer data on OLED dsiplay */
void displayAccelerometer(void *parameter) {
  int xChangeValue;
  int yChangeValue;
  int zChangeValue;

  const unsigned char acclIndicator[] PROGMEM = {
    0x00, 0x00, 0x00, 0x00, 0x00, 0x00, 0x00, 0x00, 0x00, 0x00, 0x00, 0x00, 0x00, 0x00, 0x00, 0x00,
    0x00, 0x00, 0x00, 0x00, 0x00, 0x00, 0x00, 0x00, 0x00, 0x00, 0x00, 0x00, 0x00, 0x00, 0x00, 0x00,
    0x00, 0x00, 0x00, 0x00, 0x00, 0x00, 0x00, 0x00, 0x00, 0x00, 0x00, 0x00, 0x00, 0x00, 0x00, 0x00,
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    0x00, 0x00, 0x00, 0x00, 0x00, 0x00, 0x00, 0x00, 0x00, 0x00, 0x00, 0x00, 0x00, 0x00, 0x00, 0x00
  };

  display.setTextColor(WHITE);  // Set the color

  while (true) {
    xQueueReceive(adxlQueue_x, (void *)&xChangeValue, 0);
    xQueueReceive(adxlQueue_y, (void *)&yChangeValue, 0);
    xQueueReceive(adxlQueue_z, (void *)&zChangeValue, 0);

    if (oledDisplayState == 2) {
      display.drawBitmap(7, 8, acclIndicator, 128, 64, WHITE);

      display.setTextSize(1);
      display.setCursor(7, 4);
      display.print("X:");
      display.print(xChangeValue);
      display.setCursor(52, 4);
      display.print("Y:");
      display.print(yChangeValue);
      display.setCursor(97, 4);
      display.print("Z:");
      display.print(zChangeValue);

      if (abs(xChangeValue) > ADXL_THRESHOLD || abs(yChangeValue) > ADXL_THRESHOLD || abs(zChangeValue) > ADXL_THRESHOLD) {
        display.setTextSize(2);
        display.setCursor(65, 22);
        display.print("High");
      } else {
        display.setTextSize(2);
        display.setCursor(65, 22);
        display.print("Low");
      }

      display.setCursor(65, 42);
      display.print("Vib");

      display.display();
      display.clearDisplay();
    }
  }
}

/**********************************************
  Functions
**********************************************/

int readAxis(int axisPin) {
  long reading = 0;

  analogRead(axisPin);

  delay(1);

  for (int i = 0; i < SAMPLE_SIZE; i++) {
    reading += analogRead(axisPin);
  }
  return reading / (SAMPLE_SIZE * 10);
}

void configGPRS() {
  sendATcommand("AT+CFUN=1", "OK", 2000);
  sendATcommand("AT+CGATT=1", "OK", 2000);
  sendATcommand("AT+SAPBR=3,1,\"Contype\",\"GPRS\"", "OK", 2000);
  sendATcommand("AT+SAPBR=3,1,\"APN\",\"CMNET\"", "OK", 2000);
  sendATcommand("AT+SAPBR=1,1", "OK", 2000);
  sendATcommand("AT+HTTPINIT", "OK", 2000);
  sendATcommand("AT+HTTPPARA=\"CID\",1", "OK", 1000);
}

int8_t sendATcommand(char *ATcommand, char *expected_answer, unsigned int timeout) {
  uint8_t x = 0, answer = 0;
  char response[200];
  unsigned long previous;

  //Initialice the string
  memset(response, '\0', 100);
  delay(100);

  //Clean the input buffer
  while (GSM.available() > 0) GSM.read();

  if (ATcommand[0] != '\0') {
    //Send the AT command
    GSM.println(ATcommand);
  }

  x = 0;
  previous = millis();

  //this loop waits for the answer with time out
  do {
    //if there are data in the UART input buffer, reads it and checks for the asnwer
    if (GSM.available() != 0) {
      response[x] = GSM.read();
      x++;
      // check if the desired answer (OK) is in the response of the module
      if (strstr(response, expected_answer) != NULL) {
        answer = 1;
      }
    }
  } while ((answer == 0) && ((millis() - previous) < timeout));

  Serial.println(response);
  return answer;
}

void introDisplay() {
  display.clearDisplay();

  const unsigned char intro[] PROGMEM = {
    0x00, 0x00, 0x00, 0x00, 0x00, 0x00, 0x00, 0x00, 0x00, 0x00, 0x00, 0x00, 0x00, 0x00, 0x00, 0x00,
    0x00, 0x00, 0x00, 0x00, 0x00, 0x00, 0x00, 0x00, 0x00, 0x00, 0x00, 0x00, 0x00, 0x00, 0x00, 0x00,
    0x00, 0x00, 0x00, 0x00, 0x00, 0x00, 0x00, 0x00, 0x00, 0x00, 0x00, 0x00, 0x00, 0x00, 0x00, 0x00,
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    0x00, 0x00, 0x00, 0x00, 0x00, 0x00, 0x00, 0x00, 0x00, 0x00, 0x00, 0x00, 0x00, 0x00, 0x00, 0x00
  };

  digitalWrite(rgbLED_red, 0);
  digitalWrite(rgbLED_green, 0);
  digitalWrite(rgbLED_blue, 1);

  display.drawBitmap(10, 0, intro, 128, 64, WHITE);

  display.setTextColor(WHITE);  // Set the color
  display.setTextSize(2);       // Set the font size

  display.setCursor(73, 10);  // Set the cursor coordinates
  display.print("Fast");

  display.setCursor(73, 40);  // Set the cursor coordinates
  display.print("Dart");

  display.display();
  delay(4000);
  display.clearDisplay();
}

void initDisplay() {
  display.setTextSize(1);

  display.setCursor(21, 32);
  display.print("Intitalizing...");

  display.display();
  delay(10000);
  display.clearDisplay();
}

void rgbLEDHigh() {
  digitalWrite(rgbLED_red, 1);
  digitalWrite(rgbLED_green, 0);
  digitalWrite(rgbLED_blue, 0);
}

void rgbLEDLow() {
  digitalWrite(rgbLED_red, 0);
  digitalWrite(rgbLED_green, 1);
  digitalWrite(rgbLED_blue, 0);
}
